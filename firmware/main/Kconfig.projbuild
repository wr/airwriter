## firmware/main/Kconfig.projbuild
```kconfig
menu "AirWriter"

config AIRWRITER_WIFI_SSID
    string "WiFi SSID"
    default ""
    help
        Development credentials only. They land in sdkconfig, which is
        gitignored. A board without them opens its setup network, and
        credentials stored in NVS take precedence over this value.

config AIRWRITER_WIFI_PASSWORD
    string "WiFi password"
    default ""

config AIRWRITER_QUEUE_NAME
    string "Print queue name"
    default "ImageWriter II"
    help
        Before W-1088, what the iOS print sheet showed. Printers are now
        named from what they say they are (the printer list, NVS
        "printers"); this is read only as a board's old queue name, when
        it has never saved one, at its first boot on the printer list.

config AIRWRITER_DEV_MODE
    bool "Development mode"
    default n
    help
        W-1088: no longer used. It regenerated printer-uuid on every boot;
        each printer's record now keeps the uuid it was made with.

config AIRWRITER_UUID_EPOCH
    int "printer-uuid epoch"
    range 0 65535
    default 1
    help
        The printer-uuid is fixed per board (from its MAC) plus this number.
        iOS keys everything about a printer on its UUID, including a cached
        copy of its capabilities: when operations-supported changed under an
        unchanged UUID on the rev A bench, the iPhone held every job at
        "Waiting" and only re-polled Get-Printer-Attributes. Bump this when
        the advertised capabilities change, so phones meet a new printer.
        W-1088: kept only by a port printer carried over from before the
        printer list; records made since have their own UUIDs.
        Not for changes that only filter what is sent: a new UUID also
        strands every Mac queue whose device-uri pins the old one.

config AIRWRITER_LASER_UUID_EPOCH
    int "LaserWriter printer-uuid epoch"
    range 0 65535
    default 1
    help
        W-1082: a shared LaserWriter's printer-uuid is the board's MAC, this
        number and a hash of the LaserWriter's NBP name, so sharing another
        LaserWriter is another printer to iOS. Bump it when what a shared
        LaserWriter advertises changes, as AIRWRITER_UUID_EPOCH is bumped for
        the ImageWriter; the ImageWriter's UUID does not move with it.

config AIRWRITER_UART_NUM
    int "Printer UART port"
    default 1

config AIRWRITER_TX_PIN
    int "Printer TX pin"
    default 17 if IDF_TARGET_ESP32S3
    default 4
    help
        Board net UART_TX. On the AirWriter PCB this is IO17 into the
        MAX3490's DI. Devkits without a transceiver can use anything.

config AIRWRITER_RX_PIN
    int "Printer RX pin"
    default 18 if IDF_TARGET_ESP32S3
    default 5

config AIRWRITER_CTS_PIN
    int "Printer CTS pin (the printer's HSKo), -1 to disable"
    default 8 if IDF_TARGET_ESP32S3
    default -1
    help
        Board net UART_CTS, IO8, fed by the MAX3232 receiver. With this wired
        the UART peripheral stalls its own FIFO when the printer is busy, and
        the same line doubles as the paper sensor.

config AIRWRITER_HSKI_DRV_PIN
    int "SP3232 T1IN pin, -1 if absent"
    default 35 if IDF_TARGET_ESP32S3
    default -1
    help
        Board net HSKI_DRV: IO35 into U3.11, the SP3232's T1IN. Driver inputs
        have no pull-ups and must be tied, so app_main clamps this pin low as
        one of its first acts. T1OUT reaches only the DNP R9 on rev A; rev B
        ties T1IN to GND. Devkits without the transceiver leave it at -1.

config AIRWRITER_BAUD
    int "Printer baud rate"
    default 9600

config AIRWRITER_INVERT_TX
    bool "Invert the transmit line"
    default n
    help
        Insurance for the differential polarity, which is resolved from
        secondary sources but not yet confirmed against hardware. Inverting DI
        swaps Y and Z together and is electrically identical to swapping the
        pair. SPEC.md 2.4, assumption 3.

config AIRWRITER_INVERT_RX
    bool "Invert the receive line"
    default n

config AIRWRITER_INVERT_CTS
    bool "Invert the CTS (printer HSKo) line"
    default n
    help
        Insurance for the handshake polarity. The board expects HSKo asserted
        (printer ready) to reach IO8 as logic LOW through the SP3232
        receiver. If a scope on the real printer shows the opposite, turn
        this on: it flips both the UART peripheral's CTS sense and the
        watchdog's paper sensor. SPEC.md 3.9.

config AIRWRITER_STALL_TIMEOUT
    int "Seconds of HSKo deassertion mid-job before the panel asks for attention"
    default 30
    help
        The printer holds HSKo false briefly on every line; only a stall this
        long mid-job means paper, a jam or SELECT. The job pauses, it is not
        failed -- see AIRWRITER_STALL_ABORT.

config AIRWRITER_STALL_ABORT
    int "Seconds a paused job waits for the printer before it is failed"
    default 600

config AIRWRITER_DOT_GAIN
    int "Dot gain at a 50% tint, percent"
    range 0 45
    default 0
    help
        A pin's dot is as wide as its row, so neighbours overlap and a tint
        can print darker than its bits. The halftone can ask for fewer dots
        in the midtones to make up for it: 20 means a tint asked at half
        would print at seventy with no curve. 0 prints the bits as they are,
        which is what read best on paper (W-1068: a ribbon's dot gains less
        than its geometry says).

config AIRWRITER_TOP_MARGIN
    int "Top margin in 1/144 in; negative drops the page's first rows"
    range -216 144
    default -144
    help
        Paper loaded as the ImageWriter II Owner's Guide says, its leading
        edge under the paper bail, starts printing about an inch below the
        top edge, and an AirPrint page arrives as the whole sheet, its own
        blank margin included. -144 drops that inch, so the page lands where
        the iPhone laid it out. Positive adds blank paper ahead of each page.
        The settings page sets it in sixteenths of an inch, -1 1/2 to +1 in.

config AIRWRITER_LED_DATA_PIN
    int "LED chain data pin, -1 if absent"
    default 48 if IDF_TARGET_ESP32S3
    default -1
    help
        Board net LED_DATA: IO48 into U9, the 3.3-to-5V level shifter feeding
        the SK6812 chain. U9's input has no pull-down on rev A, so the chain
        sees noise from power-on until app_main clamps this pin low as its
        first act. led_grid takes the pin over when that component lands.
        Devkits without the level shifter leave it at -1.

config AIRWRITER_LED_COUNT
    int "LED chain length"
    default 37
    help
        37 on the AirWriter board (D10-D46). A devkit with a shorter SK6812
        strip sets its real count; frames are rendered for the board's 37
        dots and truncated to the strip.

config AIRWRITER_UART_LOOPBACK
    bool "Loop the printer UART back on itself"
    default y if !IDF_TARGET_ESP32S3
    default n
    help
        Feeds TX straight back into RX inside the peripheral so the whole path
        can be checked on a devkit with no transceiver attached. The received
        bytes are checksummed and compared with what was sent. Never enable
        this on a real board: nothing reaches the printer.

config AIRWRITER_DIP1_PIN
    int "DIP1 pin, -1 if absent"
    default 38 if IDF_TARGET_ESP32S3
    default -1
    help
        Board net DIP1, closed = GND, internal pull-up.

config AIRWRITER_DIP2_PIN
    int "DIP2 pin, -1 if absent"
    default 39 if IDF_TARGET_ESP32S3
    default -1
    help
        Board net DIP2, closed = GND, internal pull-up.

config AIRWRITER_DIP3_PIN
    int "DIP3 pin, -1 if absent"
    default 40 if IDF_TARGET_ESP32S3
    default -1
    help
        Board net DIP3, closed = GND, internal pull-up.

config AIRWRITER_DIP4_PIN
    int "DIP4 pin, -1 if absent"
    default 41 if IDF_TARGET_ESP32S3
    default -1
    help
        Board net DIP4, closed = GND, internal pull-up.

config AIRWRITER_DIP5_PIN
    int "DIP5 pin, -1 if absent"
    default 42 if IDF_TARGET_ESP32S3
    default -1
    help
        Board net DIP5, closed = GND, internal pull-up.

config AIRWRITER_DIP6_PIN
    int "DIP6 pin, -1 if absent"
    default 47 if IDF_TARGET_ESP32S3
    default -1
    help
        Board net DIP6, closed = GND, internal pull-up.

config AIRWRITER_DIP7_PIN
    int "DIP7 pin, -1 if absent"
    default 21 if IDF_TARGET_ESP32S3
    default -1
    help
        Board net DIP7, closed = GND, internal pull-up.

config AIRWRITER_DIP8_PIN
    int "DIP8 pin, -1 if absent"
    default 13 if IDF_TARGET_ESP32S3
    default -1
    help
        Board net DIP8, closed = GND, internal pull-up.

config AIRWRITER_TEST_BTN_PIN
    int "Test-page button pin, -1 if absent"
    default 14 if IDF_TARGET_ESP32S3
    default -1
    help
        Board net TEST_BTN, closed = GND, internal pull-up. A press prints a
        self-test page through the same raster and serial path as a real job.

config AIRWRITER_PIC_MCLR_PIN
    int "LocalTalk PIC MCLR pin, -1 if absent"
    default 2 if IDF_TARGET_ESP32S3
    default -1
    help
        Board net LT_RESET, straight to U7 pin 4 (RA3/MCLR). Low holds TashTalk
        in reset; low plus the LVP key puts the PIC in programming mode. The
        three PIC pins together enable the web UI's "flash TashTalk" button.
        On a devkit, wire them to a breadboard PIC and set them here.

config AIRWRITER_PIC_CLK_PIN
    int "LocalTalk PIC ICSPCLK pin, -1 if absent"
    default 4 if IDF_TARGET_ESP32S3
    default -1
    help
        Board net LT_UART_TX, through R15 (100R) to U7 pin 6 (RA1/ICSPCLK).
        TashTalk's UART receive line in normal running, so app_main clamps it
        high (UART idle) at boot rather than leave TashTalk decoding a float.

config AIRWRITER_PIC_DAT_PIN
    int "LocalTalk PIC ICSPDAT pin, -1 if absent"
    default 5 if IDF_TARGET_ESP32S3
    default -1
    help
        Board net LT_UART_RX, through R16 (100R) to U7 pin 7 (RA0/ICSPDAT).
        TashTalk's UART transmit line in normal running.

config AIRWRITER_LT_UART_NUM
    int "LocalTalk UART"
    default 2 if IDF_TARGET_ESP32S3
    default 0
    help
        The UART the LocalTalk node talks to TashTalk on, at 1 Mbaud. UART2 on
        the S3 (UART1 is the printer's).

config AIRWRITER_LT_CTS_PIN
    int "LocalTalk CTS pin from TashTalk, -1 if absent"
    default 6 if IDF_TARGET_ESP32S3
    default -1
    help
        Board net LT_CTS, straight from U7 pin 5 (RA2), TashTalk's CTS out:
        low when its 128-byte queue can take more. The node's UART uses it
        for hardware flow control; a frame can be 605 bytes, so without it
        (-1, a devkit) a long frame can overrun TashTalk.

config AIRWRITER_LT_NBP_TYPE
    string "LocalTalk NBP type"
    default "ImageWriter"
    help
        What the node registers as, object:type@*. "ImageWriter" is what
        Apple's ImageWriter II/LQ LocalTalk Option Card registers and what
        the Chooser's AppleTalk ImageWriter driver looks up (W-1051).

config AIRWRITER_LT_BENCH
    bool "LocalTalk: run the node whatever DIP1-2 say (bench)"
    default n
    depends on AIRWRITER_PIC_CLK_PIN >= 0 && AIRWRITER_PIC_DAT_PIN >= 0
    help
        The LocalTalk node (W-1051) normally runs only in DIP mode 2. This
        starts it at boot regardless, for a bench board whose DIPs are set
        for something else. Either way the node holds the PIC's pins, so the
        web UI's TashTalk flash refuses while it runs. To take a LocalTalk job
        with no printer on J2, add AIRWRITER_UART_LOOPBACK: the line then
        reads ready and the job's bytes are checked as they come back.

config AIRWRITER_UPDATE_REPO
    string "Firmware updates: GitHub repository (owner/name)"
    default "wr/airwriter"
    help
        Where the board looks for releases (W-1048): the newest release's
        airwriter.json, then the image it names. A fork that publishes its
        own releases, signed with its own key, names its repository here and
        its key's digest below.

config AIRWRITER_UPDATE_KEY_DIGEST
    string "Firmware updates: release key digest (64 hex digits)"
    default "6f11af9cd8eec9923985957400aa753ba034e7e057e18ebf61033cb4d327ad89"
    help
        SHA-256 of the release key's public part, as espsecure.py
        digest_sbv2_public_key prints it. A board whose running image is
        signed with another key cannot take these releases, and the web page
        says so instead of downloading one to have it refused. The check that
        matters is esp_ota_end's; this only spares the download.

config AIRWRITER_UPDATE_FIRST_MIN
    int "Auto-update: first check, minutes after joining Wi-Fi"
    default 10

config AIRWRITER_UPDATE_INTERVAL_H
    int "Auto-update: hours between checks"
    default 24

config AIRWRITER_UPDATE_IDLE_MIN
    int "Auto-update: minutes without a job before installing"
    default 10

endmenu
```
